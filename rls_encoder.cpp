#include "rls_encoder.h"

// CRC8 Lookup Table (polynomial 0x97)
static const uint8_t CRC8_LUT[256] = {
    0x00,0x97,0xB9,0x2E,0xE5,0x72,0x5C,0xCB,0x5D,0xCA,0xE4,0x73,0xB8,0x2F,0x01,0x96,
    0xBA,0x2D,0x03,0x94,0x5F,0xC8,0xE6,0x71,0xE7,0x70,0x5E,0xC9,0x02,0x95,0xBB,0x2C,
    0xE3,0x74,0x5A,0xCD,0x06,0x91,0xBF,0x28,0xBE,0x29,0x07,0x90,0x5B,0xCC,0xE2,0x75,
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    0xAA,0x3D,0x13,0x84,0x4F,0xD8,0xF6,0x61,0xF7,0x60,0x4E,0xD9,0x12,0x85,0xAB,0x3C
};

uint8_t RLS_Encoder::crcSPI64(uint64_t input) const {
    uint8_t idx = 0;
    for (int i = 7; i >= 0; i--) {
        uint8_t byte = (input >> (8 * i)) & 0xFF;
        idx = CRC8_LUT[idx ^ byte];
    }
    return idx;
}

// Constructor
RLS_Encoder::RLS_Encoder(uint8_t cs_pin) : _cs_pin(cs_pin), _crc_valid(false), _resolution(0) {}

// Initialize SPI and CS pin
void RLS_Encoder::begin(uint32_t resolution) {
    _resolution = resolution;
    pinMode(_cs_pin, OUTPUT);
    digitalWrite(_cs_pin, HIGH);
    SPI.begin();
}

// Read absolute angle (returns -1.0f on error)
float RLS_Encoder::readAngle() {
    uint8_t rx[6];
    uint64_t crc_input = 0;
    uint32_t pos_raw;
    uint8_t calc_crc, recv_crc;

    digitalWrite(_cs_pin, LOW);
    delayMicroseconds(1);
    for (int i = 0; i < 6; i++) {
        rx[i] = SPI.transfer(0x00);
    }
    digitalWrite(_cs_pin, HIGH);

    // Prepare CRC input (first 5 bytes)
    crc_input = ((uint64_t)rx[0] << 32) |
                ((uint64_t)rx[1] << 24) |
                ((uint64_t)rx[2] << 16) |
                ((uint64_t)rx[3] << 8)  |
                ((uint64_t)rx[4]);

    calc_crc = ~(crcSPI64(crc_input)) & 0xFF;
    recv_crc = rx[5];
    _crc_valid = (recv_crc == calc_crc);

    // Check CRC and status bit (bit 1 of rx[3])
    if (!_crc_valid || ((rx[3] & 0x02) == 0)) {
        return -1.0f;
    }

    pos_raw = ((uint32_t)rx[2] << 16) |
              ((uint32_t)rx[3] << 8) |
              ((uint32_t)rx[4]);
    pos_raw >>= 6; // 18-bit position

    return (float)pos_raw * 360.0f / _resolution;
}

// Read multiturn counter (16-bit)
uint16_t RLS_Encoder::readMultiturn() const {
    uint8_t rx[6];

    digitalWrite(_cs_pin, LOW);
    delayMicroseconds(1);
    for (int i = 0; i < 6; i++) {
        rx[i] = SPI.transfer(0x00);
    }
    digitalWrite(_cs_pin, HIGH);

    return ((uint16_t)rx[0] << 8) | rx[1];
}

// Return last CRC status
bool RLS_Encoder::crcValid() const {
    return _crc_valid;
}
